## yocto/meta-jetson-ai-detect/conf/layer.conf
```bitbake
# Layer configuration for meta-jetson-ai-detect
BBPATH .= ":${LAYERDIR}"

BBFILES += "${LAYERDIR}/recipes-*/*/*.bb \
            ${LAYERDIR}/recipes-*/*/*.bbappend"

BBFILE_COLLECTIONS += "meta-jetson-ai-detect"
BBFILE_PATTERN_meta-jetson-ai-detect = "^${LAYERDIR}/"
BBFILE_PRIORITY_meta-jetson-ai-detect = "10"

LAYERDEPENDS_meta-jetson-ai-detect = "core tegra openembedded-layer"
LAYERSERIES_COMPAT_meta-jetson-ai-detect = "dunfell"
```
